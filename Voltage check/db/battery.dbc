VERSION "1.0"

NS_ :

    SG_MUL_VAL_;

BS_:

BU_: BMS

BO_ 257 BatteryVoltage: 8 BMS
 SG_ Voltage : 0|16@1+ (0.001,0) [0|10] "V" Vector__XXX

CM_ SG_ 257 Voltage "Battery pack voltage in volts. Encoded as unsigned int in millivolts.";
